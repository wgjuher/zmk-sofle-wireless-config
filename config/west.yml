## config/west.yml
```yaml
manifest:
  remotes:
    # This is the ZMK Firmware remote, which contains the main ZMK codebase.
    - name: zmkfirmware
      url-base: https://github.com/zmkfirmware
  projects:
    - name: zmk
      remote: zmkfirmware
      revision: main
      import: app/west.yml
  self:
    path: config
```
